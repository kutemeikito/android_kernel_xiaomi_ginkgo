## drivers/input/fingerprint/Kconfig
```kconfig
#
# Fingerprint driver configuration
#
menuconfig INPUT_FINGERPRINT
	bool "Fingerprints"
	help
	  Say Y here, and a list of supported fingerprints will be displayed.
	  This option doesn't affect the kernel.

	  If unsure, say Y.

if INPUT_FINGERPRINT

config FINGERPRINT_FPC1020
	tristate "fpc fpc1020 fingerprint drvier support"
	help
	  say y here to enable fpc fingerprint driver support!

source "drivers/input/fingerprint/gf3208/Kconfig"

endif
```

## drivers/input/fingerprint/gf3208/Kconfig
```kconfig
config FINGERPRINT_GF3208
	tristate "goodix fingerprint gf3208"
	help
	  say y to enable gf3208 goodix driver

	  If unsure, say N.

	  To compile this driver as a module, choose M here.
```

## drivers/input/touchscreen/nt36xxx_spi_c3j/Kconfig
```kconfig
#
# Novatek NT36xxx touchscreen driver configuration
#
config TOUCHSCREEN_NT36xxx_HOSTDL_SPI_C3J
	bool "Novatek NT36xxx host download SPI driver"
	depends on ( SPI || TOUCHSCREEN_XIAOMI_C3J )
	default n
	help
	  Say Y here if you have a Novatek NT36xxx no flash touchscreen connected
	  to your system by SPI bus.

	  If unsure, say N.


if TOUCHSCREEN_NT36xxx_C3J

config TOUCHSCREEN_NT36xxx_C3J_MP
	bool "Novatek NT36xxx MP"
	default n
	help
	  Say Y here to disable NT36xxx MP

endif
```

## drivers/platform/Kconfig
```kconfig
if X86
source "drivers/platform/x86/Kconfig"
endif
if MIPS
source "drivers/platform/mips/Kconfig"
endif

source "drivers/platform/goldfish/Kconfig"

source "drivers/platform/chrome/Kconfig"

source "drivers/platform/msm/Kconfig"

if ARCH_TRINKET
source "drivers/platform/ginkgo/Kconfig"
endif
```

## drivers/platform/ginkgo/Kconfig
```kconfig
config MACH_XIAOMI_GINKGO
	bool "Xiaomi Redmi Note 8"
	depends on ARCH_TRINKET
	help
	  Support for Xiaomi Redmi Note 8.
```
