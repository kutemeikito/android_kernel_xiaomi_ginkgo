/*
 * Copyright (c) 2019, The Linux Foundation. All rights reserved.
 * Copyright (C) 2021 XiaoMi, Inc.
 *
 * This program is free software; you can redistribute it and/or modify
 * it under the terms of the GNU General Public License version 2 and
 * only version 2 as published by the Free Software Foundation.
 *
 * This program is distributed in the hope that it will be useful,
 * but WITHOUT ANY WARRANTY; without even the implied warranty of
 * MERCHANTABILITY or FITNESS FOR A PARTICULAR PURPOSE.  See the
 * GNU General Public License for more details.
 */

&usb0{
	dwc3@4e00000 {
		usb-phy = <&qusb_phy0>, <&usb_nop_phy>;
		maximum-speed = "high-speed";
	};
};

&qusb_phy0 {
	qcom,qusb-phy-init-seq = <0xf8 0x80
				  0xa3 0x84
				  0x81 0x88
				  0xc7 0x8c
				  0x30 0x08
				  0x79 0x0c
				  0x21 0x10
				  0x14 0x9c
				  0x80 0x04
				  0x9f 0x1c
				  0x00 0x18>;

	qcom,qusb-phy-init-seq-no-panel = <0xc8 0x80
					   0xe3 0x84
					   0x81 0x88
					   0xc0 0x8c
					   0x30 0x08
					   0x79 0x0c
					   0x21 0x10
					   0x14 0x9c
					   0x80 0x04
					   0x9f 0x1c
					   0x00 0x18>;
};

&usb_qmp_phy {
	status = "disabled";
};
